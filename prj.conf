## CMakeLists.txt
```
cmake_minimum_required(VERSION 3.20.0)
find_package(Zephyr REQUIRED HINTS $ENV{ZEPHYR_BASE})

project(handheld)

target_include_directories(app PRIVATE ${CMAKE_CURRENT_SOURCE_DIR}/inc)

target_sources(app PRIVATE src/main.c src/lcd_segments.c src/lcd_driver.c)
```

## prj.conf
```kconfig
# I2C Configuration
CONFIG_I2C=y

# Logging
CONFIG_LOG=y
CONFIG_LOG_MODE_IMMEDIATE=y
CONFIG_I2C_LOG_LEVEL_DBG=y

# Stack sizes
CONFIG_MAIN_STACK_SIZE=2048
CONFIG_SYSTEM_WORKQUEUE_STACK_SIZE=2048

# Console (for viewing logs)
CONFIG_CONSOLE=y
CONFIG_UART_CONSOLE=y
CONFIG_SERIAL=y
CONFIG_PRINTK=y

# RTT (SEGGER Real-Time Transfer) for debugging
CONFIG_USE_SEGGER_RTT=y
CONFIG_RTT_CONSOLE=y
CONFIG_UART_CONSOLE=n
CONFIG_LOG_BACKEND_RTT=y
CONFIG_LOG_BACKEND_UART=n

# RTT Buffer sizes (increase if you get buffer overflow)
CONFIG_SEGGER_RTT_BUFFER_SIZE_UP=4096
CONFIG_SEGGER_RTT_BUFFER_SIZE_DOWN=16

# Optional: Enable RTT for printk as well
CONFIG_PRINTK=y
```

## 805hp-lcd.overlay
```dts
/* PCF8576 LCD I2C Configuration for 805HP-LCD Board */

&i2c0 {
    compatible = "nordic,nrf-twim";
    status = "okay";
    clock-frequency = <I2C_BITRATE_STANDARD>;
    
    /* Increase buffer size for PCF8576 40-byte writes */
    zephyr,concat-buf-size = <48>;
};

/ {
    aliases {
        i2c-lcd0 = &i2c0;
    };
};
```

## src/main.c
```c
#include <zephyr/kernel.h>
#include <zephyr/logging/log.h>
#include "lcd_driver.h"

LOG_MODULE_REGISTER(main, LOG_LEVEL_INF);

void main(void)
{
    LOG_INF("=== PCF8576 LCD Demo ===");

    int ret = lcd_init();
    if (ret) {
        LOG_ERR("LCD init failed: %d", ret);
        return;
    }

    k_msleep(200);
    lcd_show_number(123456,4);
        
    LOG_INF("All segments ON");
}
```

## inc/lcd_driver.h
```c
#ifndef LCD_DRIVER_H
#define LCD_DRIVER_H

#include <stdint.h>
#include <stddef.h>

int lcd_init(void);
int lcd_write_data(uint8_t addr, const uint8_t *data, size_t len);
int lcd_clear(void);
int lcd_test_all_segments(void);
void lcd_test_walking_active_segments(void);
void lcd_test_mapping (void);
void lcd_test_walk_by_S(void);
int lcd_test_active_segments(void);
int showUnitNewton(void);
int showUnitGram(void);
int showUnitPound(void);
int showUnitTon(void);
int showUnitKPound(void);
int showUnitKNewton(void);
int showUnitKGram(void);
int showDecimalPoints(int pos);
int showCharacterByPosition(int pos, uint8_t value);
int showCharacterByPositionChar(int pos, char ch);
int lcd_show_string(const char *str);

/** Show a number (decimal or hexadecimal) on the display. */
int lcd_show_number(double value, int decimal_pos);
#endif
```

## inc/lcd_segments.h
```c
#ifndef LCD_SEGMENTS_H
#define LCD_SEGMENTS_H

#include <stdint.h>
#include <stdbool.h>

/*
 * PCF8576DT LCD Segment Mapping (1/4 duty)
 * -----------------------------------------
 * Each LCD segment = one S-line (0–39) × COM index (0–3)
 * Safe for all Zephyr + picolibc toolchains.
 */

typedef struct {
    uint8_t s;   /* Segment index (S0–S39) */
    uint8_t com; /* COM index (0–3) */
} seg_t;

/* Macro replaced with inline initializer for GCC safety */
static inline seg_t make_seg(uint8_t s, uint8_t com)
{
    seg_t seg = { s, com };
    return seg;
}

/* Digit map lookup (6 digits × 8 segments [A–G + DP]) */
extern const seg_t *digit_map[6];

/* Display control */
void lcd_show_digit(uint8_t pos, uint8_t value, uint8_t *ram);
void lcd_show_number(uint32_t value, uint8_t *ram);

/* Diagnostic helper */
void lcd_test_digit_segments(uint8_t pos, uint8_t *ram);

#endif /* LCD_SEGMENTS_H */
```

## src/lcd_driver.c
```c
#include "lcd_driver.h"
#include <zephyr/kernel.h>
#include <zephyr/device.h>
#include <zephyr/drivers/i2c.h>
#include <zephyr/logging/log.h>
#include <string.h>

LOG_MODULE_REGISTER(lcd_driver, LOG_LEVEL_INF);

/* --- Hardware config --- */
#define LCD_I2C_NODE DT_ALIAS(i2c_lcd0)
#define LCD_ADDR 0x38

/* --- Command constants --- */
#define CMD_CONTINUE        0x80
#define CMD_LAST            0x00
#define CMD_MODE_SET        0x40
#define CMD_LOAD_DP         0x00
#define CMD_DEVICE_SELECT   0x60

#define MODE_ENABLE         (1 << 3)
#define MODE_BIAS_1_3       (0 << 2)
#define MODE_DRIVE_1_4      (0x00)
#define LCD_RAM_SIZE        20

/* --- Segment bit mapping --- */
#define SEG_A (1 << 3)   // from display_ram[18 - pos]
#define SEG_F (1 << 1)
#define SEG_E (1 << 2)
#define SEG_D (1 << 0)

#define SEG_B (1 << 7)   // from display_ram[19 - pos]
#define SEG_G (1 << 5)
#define SEG_C (1 << 6)

/* --- Internal state --- */
static const struct device *i2c_dev;
static uint8_t display_ram[LCD_RAM_SIZE];
static bool initialized = false;

/* --- I2C helper --- */
static int lcd_i2c_write(const uint8_t *buf, size_t len)
{
    int ret = i2c_write(i2c_dev, buf, len, LCD_ADDR);
    if (ret)
        LOG_ERR("I2C write (%d bytes) failed: %d", len, ret);
    return ret;
}

/* --- Initialization --- */
int lcd_init(void)
{
    int ret;
    uint8_t buf[3];

    i2c_dev = DEVICE_DT_GET(LCD_I2C_NODE);
    if (!device_is_ready(i2c_dev)) {
        LOG_ERR("I2C bus not ready");
        return -ENODEV;
    }

    LOG_INF("Initializing PCF8576DT at 0x%02X", LCD_ADDR);
    k_msleep(100);

    uint8_t mode = MODE_ENABLE | MODE_BIAS_1_3 | MODE_DRIVE_1_4;
    buf[0] = CMD_CONTINUE | CMD_MODE_SET | mode;
    buf[1] = CMD_CONTINUE | CMD_LOAD_DP;
    buf[2] = CMD_LAST | CMD_DEVICE_SELECT | 0x00;

    ret = lcd_i2c_write(buf, 3);
    if (ret)
        return ret;

    memset(display_ram, 0, sizeof(display_ram));
    initialized = true;

    return lcd_clear();
}

/* --- Write RAM --- */
int lcd_write_data(uint8_t addr, const uint8_t *data, size_t len)
{
    if (!initialized)
        return -ENODEV;
    if (addr + len > sizeof(display_ram))
        return -EINVAL;

    uint8_t buf[22];
    buf[0] = CMD_CONTINUE | CMD_LOAD_DP | (addr & 0x3F);
    buf[1] = CMD_LAST | CMD_DEVICE_SELECT | 0x00;
    memcpy(&buf[2], data, len);

    return lcd_i2c_write(buf, len + 2);
}

/* --- Clear display --- */
int lcd_clear(void)
{
    memset(display_ram, 0, sizeof(display_ram));
    return lcd_write_data(0, display_ram, sizeof(display_ram));
}

/* --- Test patterns --- */
int lcd_test_all_segments(void)
{
    memset(display_ram, 0xFF, sizeof(display_ram));
    return lcd_write_data(0, display_ram, sizeof(display_ram));
}

void lcd_test_walking_segments(void)
{
    if (!initialized)
        return;

    memset(display_ram, 0x00, sizeof(display_ram));
    for (int i = 10; i < 20; i++)
        display_ram[i] = 0xFF;

    int ret = lcd_write_data(0, display_ram, sizeof(display_ram));
    if (ret == 0)
        LOG_INF("Active segments (S20–S39) ON");
    else
        LOG_ERR("Failed to update active segment range: %d", ret);
}

void lcd_test_walking_active_segments(void)
{
    if (!initialized)
        return;

    LOG_INF("Starting walking segment test (S20–S39)...");
    memset(display_ram, 0x00, sizeof(display_ram));

    for (int s = 10; s < 20; s++) {
        for (int com = 0; com < 4; com++) {
            memset(display_ram, 0x00, sizeof(display_ram));
            display_ram[s] = (1 << com);
            int ret = lcd_write_data(0, display_ram, sizeof(display_ram));
            if (ret < 0) {
                LOG_ERR("Write failed at S=%d COM=%d: %d", s, com, ret);
                return;
            }
            LOG_INF("Lighting S%d (COM%d)", s, com);
            k_msleep(300);
        }
    }
    LOG_INF("Walking segment test done.");
}

void lcd_test_mapping(void)
{
    if (!initialized)
        return;

    LOG_INF("Starting full mapping test (S0–S39, COM0–3)...");
    memset(display_ram, 0x00, sizeof(display_ram));

    for (int s = 0; s < 40; s++) {
        for (int com = 0; com < 4; com++) {
            memset(display_ram, 0x00, sizeof(display_ram));
            display_ram[s] = (1 << com);
            lcd_write_data(0, display_ram, sizeof(display_ram));
            LOG_INF("Lighting S%d COM%d", s, com);
            k_msleep(400);
        }
    }
    LOG_INF("Mapping test complete.");
}

void lcd_test_walk_by_S(void)
{
    if (!initialized)
        return;

    LOG_INF("Walking by S-line (lighting all COMs per S)...");
    memset(display_ram, 0x00, sizeof(display_ram));

    for (int s = 0; s < 40; s++) {
        memset(display_ram, 0x00, sizeof(display_ram));
        display_ram[s] = 0xFF;
        lcd_write_data(0, display_ram, sizeof(display_ram));
        LOG_INF("Lighting S%d (COM0–3)", s);
        k_msleep(400);
    }
    LOG_INF("Walk-by-S complete.");
}

/* --- Display test --- */
int lcd_test_active_segments(void)
{
    memset(display_ram, 0x00, sizeof(display_ram));
    display_ram[17] &= ~(SEG_A | SEG_F | SEG_E | SEG_D);
    display_ram[18] = (SEG_B | SEG_C);
    return lcd_write_data(0, display_ram, sizeof(display_ram));
}

/* --- Character patterns --- */
typedef struct {
    uint8_t low;
    uint8_t high;
} seg_pattern_t;

static const seg_pattern_t seg_map[36] = {
    /* 0–9 */
    {SEG_A | SEG_F | SEG_E | SEG_D, SEG_B | SEG_C},             // 0
    {0, SEG_B | SEG_C},                                         // 1
    {SEG_A | SEG_E | SEG_D, SEG_B | SEG_G},                     // 2
    {SEG_A | SEG_D, SEG_B | SEG_G | SEG_C},                     // 3
    {SEG_F, SEG_B | SEG_G | SEG_C},                             // 4
    {SEG_A | SEG_F | SEG_D, SEG_G | SEG_C},                     // 5
    {SEG_A | SEG_F | SEG_E | SEG_D, SEG_G | SEG_C},             // 6
    {SEG_A, SEG_B | SEG_C},                                     // 7
    {SEG_A | SEG_F | SEG_E | SEG_D, SEG_B | SEG_G | SEG_C},     // 8
    {SEG_A | SEG_F | SEG_D, SEG_B | SEG_G | SEG_C},             // 9

    /* A–Z */
    {SEG_A | SEG_F | SEG_E, SEG_B | SEG_G | SEG_C},             // A
    {SEG_F | SEG_E | SEG_D, SEG_G | SEG_C},                     // b
    {SEG_A | SEG_F | SEG_E | SEG_D, 0},                         // C
    {SEG_E | SEG_D, SEG_B | SEG_G | SEG_C},                     // d
    {SEG_A | SEG_F | SEG_E | SEG_D, SEG_G},                     // E
    {SEG_A | SEG_F | SEG_E, SEG_G},                             // F
    {SEG_A | SEG_F | SEG_E | SEG_D, SEG_C | SEG_G},             // G
    {SEG_F | SEG_E, SEG_B | SEG_G | SEG_C},                     // H
    {0, SEG_B | SEG_C},                                         // I (same as 1)
    {SEG_E | SEG_D, SEG_B | SEG_C},                             // J
    {SEG_F | SEG_E | SEG_D, SEG_G | SEG_C},                     // K (approximation)
    {SEG_F | SEG_E | SEG_D, 0},                                 // L
    {SEG_E, SEG_B | SEG_C},                                     // M (approximation)
    {SEG_E | SEG_G, SEG_C},                                     // N (approximation)
    {SEG_A | SEG_F | SEG_E | SEG_D, SEG_B | SEG_C},             // O
    {SEG_A | SEG_F | SEG_E, SEG_B | SEG_G},                     // P
    {SEG_A | SEG_F | SEG_E | SEG_D, SEG_B | SEG_C | SEG_G},     // Q
    {SEG_E | SEG_G, SEG_B | SEG_C},                             // R (approximation)
    {SEG_A | SEG_F | SEG_D, SEG_G | SEG_C},                     // S
    {0, SEG_B | SEG_G},                                         // T (approximation)
    {SEG_F | SEG_E | SEG_D, SEG_B | SEG_C},                     // U
    {SEG_E | SEG_D, SEG_C},                                     // V (approximation)
    {SEG_E | SEG_D, SEG_B | SEG_C | SEG_G},                     // W (approximation)
    {SEG_F | SEG_E, SEG_B | SEG_C | SEG_G},                     // X (approximation)
    {SEG_F | SEG_D, SEG_B | SEG_G | SEG_C},                     // Y
    {SEG_A | SEG_E | SEG_D, SEG_B | SEG_G}                      // Z
};

/* --- Display character by position --- */

int showCharacterByPositionChar(int pos, char ch)
{
    uint8_t value;

    if (ch >= '0' && ch <= '9') {
        value = ch - '0';
    } else if (ch >= 'A' && ch <= 'F') {
        value = 10 + (ch - 'A');
    } else if (ch >= 'a' && ch <= 'f') {
        value = 10 + (ch - 'a');
    } else {
        // unsupported → clear the position
        uint8_t low_index  = 18 - pos;
        uint8_t high_index = 19 - pos;
        const uint8_t LOW_MASK  = SEG_A | SEG_F | SEG_E | SEG_D;
        const uint8_t HIGH_MASK = SEG_B | SEG_G | SEG_C;
        display_ram[low_index]  &= ~LOW_MASK;
        display_ram[high_index] &= ~HIGH_MASK;
        return lcd_write_data(0, display_ram, sizeof(display_ram));
    }

    return showCharacterByPosition(pos, value);
}


int showCharacterByPosition(int pos, uint8_t value)
{
    if (!initialized)
        return -ENODEV;

    if (pos < 0 || pos > 6 || value > 0xF)
        return -EINVAL;

    uint8_t low_index  = 11 + pos;   // AFED
    uint8_t high_index = 12 + pos;   // BGC

    // Masks for this digit’s segment bits
    const uint8_t LOW_MASK  = SEG_A | SEG_F | SEG_E | SEG_D;
    const uint8_t HIGH_MASK = SEG_B | SEG_G | SEG_C;

    // 1️⃣ Clear only the bits that belong to this digit
    display_ram[low_index]  &= ~LOW_MASK;
    display_ram[high_index] &= ~HIGH_MASK;

    // 2️⃣ Set new bits for this value (don’t affect others)
    display_ram[low_index]  |= seg_map[value].low;
    display_ram[high_index] |= seg_map[value].high;

    // 3️⃣ Push to LCD
    return lcd_write_data(0, display_ram, sizeof(display_ram));
}

/* --- Decimal points --- */
int showDecimalPoints(int pos)
{
    display_ram[12 + pos] |= (1 << 4);
    return lcd_write_data(0, display_ram, sizeof(display_ram));
}

/* --- Unit indicators --- */
int showUnitKPound(void)
{
    display_ram[18] |= (1 << 2);
    showUnitPound();
    return lcd_write_data(0, display_ram, sizeof(display_ram));
}

int showUnitKGram(void)
{
    display_ram[18] |= (1 << 1);
    showUnitGram();
    return lcd_write_data(0, display_ram, sizeof(display_ram));
}

int showUnitKNewton(void)
{
    display_ram[18] |= (1 << 3);
    showUnitGram();
    return lcd_write_data(0, display_ram, sizeof(display_ram));
}

int showUnitTon(void)
{
    display_ram[18] |= (1 << 0);
    return lcd_write_data(0, display_ram, sizeof(display_ram));
}

int showUnitNewton(void)
{
    display_ram[19] |= (1 << 7);
    return lcd_write_data(0, display_ram, sizeof(display_ram));
}

int showUnitPound(void)
{
    display_ram[19] |= (1 << 6);
    return lcd_write_data(0, display_ram, sizeof(display_ram));
}

int showUnitGram(void)
{
    display_ram[19] |= (1 << 5);
    return lcd_write_data(0, display_ram, sizeof(display_ram));
}

int showUnitThreeDots(void)
{
    display_ram[19] |= (1 << 4);
    return lcd_write_data(0, display_ram, sizeof(display_ram));
}
int lcd_show_string(const char *str)
{
    if (!initialized)
        return -ENODEV;

    size_t len = strlen(str);

    /* We only have 6 digits — fill from right to left (LSB on rightmost) */
    for (int i = 0; i < 6; i++) {
        int pos = i;
        char ch = ' ';  // blank if shorter than 6

        /* show right-aligned text by default */
        if (len - i - 1 >= 0) {
            ch = str[len - i - 1];
        }

        showCharacterByPositionChar(pos, ch);
    }

    return 0;
}

/* --- Corrected: display numeric value directly, no scaling --- */
/* --- Corrected: display numeric value directly, no scaling --- */
int lcd_show_number(double value, int decimal_pos)
{
    if (!initialized)
        return -ENODEV;

    printf("\n[lcd_show_number] value=%.6f, decimal_pos=%d\n", value, decimal_pos);

    int negative = (value < 0);
    if (negative)
        value = -value;

    long scaled = (long)(value + 0.5); // no scaling, just rounding
    printf("[lcd_show_number] scaled=%ld\n", scaled);

    int digits[6] = {0};

    // Extract last 6 digits (right-aligned)
    for (int i = 5; i >= 0; i--) {
        digits[i] = scaled % 10;
        scaled /= 10;
    }

    printf("[lcd_show_number] extracted digits: ");
    for (int i = 0; i < 6; i++)
        printf("%d", digits[i]);
    printf("\n");

    // Display left→right
    for (int pos = 1; pos <= 6; pos++) {
        printf("[lcd_show_number] pos=%d → digit=%d\n", pos, digits[pos - 1]);
        showCharacterByPosition(pos, digits[pos - 1]);
    }

    if (negative)
        showCharacterByPosition(1, '-');

    // Just show decimal point where requested
    showDecimalPoints(decimal_pos);
    printf("[lcd_show_number] showing decimal point at pos=%d\n", decimal_pos);

    return 0;
}
```

## src/lcd_segments.c
```c
#include "lcd_segments.h"
#include <string.h>
#include <zephyr/kernel.h>  // for k_msleep()

/*
 * LCD Segment Mapping for PCF8576DT (1/4 duty)
 * COM naming avoids conflicts with Zephyr UART macros.
 */

#define COM_IDX1 0
#define COM_IDX2 1
#define COM_IDX3 2
#define COM_IDX4 3

/* ==============================================================
 * Digit segment mapping
 * ============================================================== */

static const seg_t digit0_map[8] = {
    {15, COM_IDX1}, // A
    {16, COM_IDX1}, // B
    {16, COM_IDX3}, // C
    {15, COM_IDX4}, // D
    {16, COM_IDX4}, // E
    {16, COM_IDX2}, // F
    {17, COM_IDX3}, // G
    {17, COM_IDX4}  // DP
};

static const seg_t digit1_map[8] = {
    {0, COM_IDX1}, {0, COM_IDX1}, {0, COM_IDX1},
    {0, COM_IDX1}, {0, COM_IDX1}, {0, COM_IDX1},
    {0, COM_IDX1}, {0, COM_IDX1}
};

static const seg_t digit2_map[8] = {
    {0, COM_IDX1}, {0, COM_IDX1}, {0, COM_IDX1},
    {0, COM_IDX1}, {0, COM_IDX1}, {0, COM_IDX1},
    {0, COM_IDX1}, {0, COM_IDX1}
};

static const seg_t digit3_map[8] = {
    {0, COM_IDX1}, {0, COM_IDX1}, {0, COM_IDX1},
    {0, COM_IDX1}, {0, COM_IDX1}, {0, COM_IDX1},
    {0, COM_IDX1}, {0, COM_IDX1}
};

static const seg_t digit4_map[8] = {
    {0, COM_IDX1}, {0, COM_IDX1}, {0, COM_IDX1},
    {0, COM_IDX1}, {0, COM_IDX1}, {0, COM_IDX1},
    {0, COM_IDX1}, {0, COM_IDX1}
};

static const seg_t digit5_map[8] = {
    {0, COM_IDX1}, {0, COM_IDX1}, {0, COM_IDX1},
    {0, COM_IDX1}, {0, COM_IDX1}, {0, COM_IDX1},
    {0, COM_IDX1}, {0, COM_IDX1}
};

/* Lookup table */
const seg_t *digit_map[6] = {
    digit0_map, digit1_map, digit2_map,
    digit3_map, digit4_map, digit5_map
};

/* ==============================================================
 * Segment patterns for numbers 0–9
 * ============================================================== */
static const uint8_t segmask[10] = {
    0b0111111, // 0
    0b0000110, // 1
    0b1011011, // 2
    0b1001111, // 3
    0b1100110, // 4
    0b1101101, // 5
    0b1111101, // 6
    0b0000111, // 7
    0b1111111, // 8
    0b1101111  // 9
};

/* ==============================================================
 * Internal helpers
 * ============================================================== */
static inline void set_seg(uint8_t *ram, seg_t seg, bool on)
{
    if (on)
        ram[seg.s] |= (1 << seg.com);
    else
        ram[seg.s] &= ~(1 << seg.com);
}

/* ==============================================================
 * Draw one digit (0–9)
 * ============================================================== */
void lcd_show_digit(uint8_t pos, uint8_t value, uint8_t *ram)
{
    if (pos > 5 || value > 9)
        return;

    const seg_t *map = digit_map[pos];

    for (int s = 0; s < 7; s++) {
        bool on = segmask[value] & (1 << s);
        set_seg(ram, map[s], on);
    }
}

/* ==============================================================
 * Draw full number (right aligned)
 * ============================================================== */
void lcd_show_number(uint32_t value, uint8_t *ram)
{
    for (int pos = 0; pos < 6; pos++) {
        uint8_t digit = value % 10;
        value /= 10;
        lcd_show_digit(pos, digit, ram);
    }
}

/* ==============================================================
 * Diagnostic: cycle through A–G + DP for one digit
 * ============================================================== */
void lcd_test_digit_segments(uint8_t pos, uint8_t *ram)
{
    if (pos > 5)
        return;

    const seg_t *map = digit_map[pos];

    printk("Testing digit %d...\n", pos);

    for (int s = 0; s < 8; s++) {
        memset(ram, 0x00, 40);
        set_seg(ram, map[s], true);

        /* Send buffer to PCF8576 */
        int ret = lcd_write_data(0x00, ram, 40);
        if (ret < 0) {
            printk("Segment %d write failed: %d\n", s, ret);
        } else {
            printk("Segment %d ON (S=%d, COM=%d)\n", s, map[s].s, map[s].com);
        }

        k_msleep(400);
    }

    /* Clear display after test */
    memset(ram, 0x00, 40);
    lcd_write_data(0x00, ram, 40);
}
```
